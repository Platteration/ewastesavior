## os/buildroot/Config.in
```kconfig
menu "SaviorOS"

source "$BR2_EXTERNAL_SAVIOR_PATH/package/savior-firmware/Config.in"

endmenu
```

## os/buildroot/package/savior-firmware/Config.in
```kconfig
config BR2_PACKAGE_SAVIOR_FIRMWARE
	bool "savior-firmware"
	help
	  Installs exactly the firmware files listed in
	  board/savior/firmware.list (Intel NIC and older Wi-Fi, Realtek
	  NIC, Atheros and Ralink USB/PCI Wi-Fi, radeon R100 to SI) from
	  the same linux-firmware release Buildroot's own linux-firmware
	  package uses. WHENCE "Link:" entries are recreated.

	  https://git.kernel.org/pub/scm/linux/kernel/git/firmware/linux-firmware.git
```
